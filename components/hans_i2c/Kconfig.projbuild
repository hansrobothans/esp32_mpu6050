## components/hans_i2c/Kconfig.projbuild
```kconfig
menu "I2C"

    menu "I2C Master"
        config I2C_MASTER_SCL
            int "SCL GPIO number"
            range 0 34
            default 17
            help
                GPIO number (IOxx) to I2C SCL.
                Some GPIOs are used for other purposes (flash connections, etc.) and cannot be used to SCL.
                GPIOs 35-39 are input-only so cannot be used as outputs.

        config I2C_MASTER_SDA
            int "SDA GPIO number"
            range 0 34
            default 16
            help
                GPIO number (IOxx) to I2C SDA.
                Some GPIOs are used for other purposes (flash connections, etc.) and cannot be used to SDA.
                GPIOs 35-39 are input-only so cannot be used as outputs.

        config I2C_MASTER_PORT_NUM
            int "Port Number"
            default 1
            help
                Port number for I2C Master device.

        config I2C_MASTER_FREQUENCY
            int "Master Frequency"
            default 100000
            help
                I2C Speed of Master device.
    endmenu
    menu "I2C Slave"
        config I2C_SLAVE_SCL
            int "SCL GPIO Num"
            default 5
            help
                GPIO number for I2C Slave clock line.

        config I2C_SLAVE_SDA
            int "SDA GPIO Num"
            default 4
            help
                GPIO number for I2C Slave data line.

        config I2C_SLAVE_PORT_NUM
            int "Port Number"
            default 0
            help
                Port number for I2C Slave device.

        config I2C_SLAVE_ADDRESS
            hex "ESP Slave Address"
            default 0x28
            help
                Hardware Address of I2C Slave Port.
    endmenu

    menu "oled"
        config SSD1306_WIDTH
            int "SCREEN WIDTH"
            range 0 999
            default 128
            help
                The width resolution of the screen.

        config SSD1306_HEIGHT
            int "SCREEN HEIGHT"
            range 0 999
            default 64
            help
                The height resolution of the screen.

        config OFFSETX
            int "GRAM X OFFSET"
            range 0 99
            default 0
            help
                When your TFT have offset(X), set it.

        config OFFSETY
            int "GRAM Y OFFSET"
            range 0 99
            default 0
            help
                When your TFT have offset(Y), set it.
        config INVERSION
            bool "Enable Display Inversion"
            default false
            help
                Enable Display Inversion.
    endmenu

endmenu
```
